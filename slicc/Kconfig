## slicc/Kconfig
```kconfig
config PROTOCOL
    default "MESI_unord" if RUBY_MESI_unord
    default "MESI_unord_CXL" if RUBY_MESI_unord_CXL
    default "MOESI_CMP_directory_edit" if RUBY_PROTOCOL_MOESI_CMP_DIRECTORY_EDIT



cont_choice "Ruby protocol"
    config RUBY_MESI_unord
        bool "MESI_unord"
    config RUBY_MESI_unord_CXL
        bool "MESI_unord_CXL"
    config RUBY_PROTOCOL_MOESI_CMP_DIRECTORY_EDIT
        bool "MOESI_CMP_directory_edit"
endchoice
```
